&mdss_mdp {
	dsi_m20_42_0d_0b_dsc_vid: qcom,mdss_dsi_m20_42_0d_0b_dsc_vid {
		qcom,mdss-dsi-panel-name = "xiaomi 42 0d 0b video mode dsc dsi panel";
		qcom,mdss-dsi-panel-type = "dsi_video_mode";
		qcom,mdss-dsi-virtual-channel-id = <0>;
		qcom,mdss-dsi-stream = <0>;
		qcom,mdss-dsi-bpp = <30>;
		qcom,mdss-dsi-color-order = "rgb_swap_rgb";
		qcom,mdss-dsi-underflow-color = <0xff>;
		qcom,mdss-dsi-border-color = <0>;
		qcom,dsi-ctrl-num = <0>;
		qcom,dsi-phy-num = <0>;
		qcom,mdss-dsi-traffic-mode = "burst_mode";
		qcom,mdss-dsi-lane-map = "lane_map_0123";
		qcom,mdss-dsi-bllp-eof-power-mode;
		qcom,mdss-dsi-bllp-power-mode;
		qcom,mdss-dsi-lane-0-state;
		qcom,mdss-dsi-lane-1-state;
		qcom,mdss-dsi-lane-2-state;
		qcom,mdss-dsi-lane-3-state;
		qcom,mdss-dsi-dma-trigger = "trigger_sw";
		qcom,mdss-dsi-mdp-trigger = "none";
		qcom,mdss-dsi-reset-sequence = <1 1>, <0 1>, <1 20>;
		qcom,mdss-pan-physical-width-dimension = <70>;
		qcom,mdss-pan-physical-height-dimension = <154>;
		qcom,mdss-dsi-tx-eot-append;
		qcom,mdss-dsi-lp11-init;
		qcom,mdss-dsi-bl-inverted-dbv;
		qcom,bl-update-flag = "delay_until_first_frame";
		qcom,mdss-dsi-phy-voltage = <0x51>;
		qcom,mdss-dsi-panel-hdr-enabled;
		qcom,mdss-dsi-panel-hdr-color-primaries = <14500 15500 32000 17000 15500 30000 8000 3000>;
		qcom,mdss-dsi-panel-peak-brightness = <4200000>;
		qcom,mdss-dsi-panel-blackness-level = <3230>;
		qcom,mdss-dsi-pan-enable-dynamic-fps;
		qcom,mdss-dsi-pan-fps-update = "dfps_immediate_porch_mode_vfp";
		qcom,dsi-supported-dfps-list = <120 90 60>;
		qcom,mdss-dsi-display-timings {
			timing@0 {
				qcom,mdss-dsi-panel-framerate = <120>;
				qcom,mdss-dsi-panel-width = <1080>;
				qcom,mdss-dsi-panel-height = <2400>;
				qcom,mdss-dsi-h-front-porch = <48>;
				qcom,mdss-dsi-h-back-porch = <64>;
				qcom,mdss-dsi-h-pulse-width = <4>;
				qcom,mdss-dsi-h-sync-skew = <0>;
				qcom,mdss-dsi-v-back-porch = <8>;
				qcom,mdss-dsi-v-front-porch = <20>;
				qcom,mdss-dsi-v-pulse-width = <4>;
				qcom,mdss-dsi-h-sync-pulse = <0>;
				qcom,mdss-dsi-h-left-border = <0>;
				qcom,mdss-dsi-h-right-border = <0>;
				qcom,mdss-dsi-v-top-border = <0>;
				qcom,mdss-dsi-v-bottom-border = <0>;
				qcom,mdss-dsi-on-command = <0x15010000 0x253 0x20390100 0x03 0x51000015 0x1000000 0x26f01 0x15010000 0x203 0x1150100 0x02 0x35001501 0x00 0x26c0239 0x1000000 0x5f7012 0xab30 0x80096004 0x38000c02 0x1c021c02 0x20e00 0x20011f00 0x7000c08 0xbb087a18 0x10f007 0x10200006 0xf0f330e 0x1c2a3846 0x54626970 0x77797b7d 0x7e020222 0x2a402a 0xbe3afc3a 0xfa3af83b 0x383b7843 0xb64bb64b 0xf64bf464 0x34847400 0x00 0x150100 0x02 0x59093901 0x00 0x3f0aa10 0x15010000 0x265 0x4150100 0x02 0xcf7f3901 0x00 0x3f0aa18 0x15010000 0x2b0 0x13150100 0x02 0xb2133901 0x00 0x3ff5a81 0x15010000 0x265 0x3150100 0x02 0xf4031501 0x00 0x2650839 0x1000000 0x3f651 0x44390100 0x03 0xf0aa1315 0x1000000 0x2c804 0x15010000 0x2d0 0x4150100 0x02 0xe0043901 0x00 0x3ff5a80 0x15010000 0x265 0xe150100 0x02 0xf9b91501 0x00 0x2550039 0x1000000 0x3f0aa 0x11390100 0x03 0xba821015 0x1000000 0x26501 0x15010000 0x2b0 0x81150100 0x02 0x57003901 0x00 0x3f0aa19 0x39010000 0x31d1 0x40406 0x7080809 0xfefcfa 0xfaf9f7f7 0x40406 0x7080809 0xfefcfa 0xfaf9f7f7 0x40406 0x7080809 0xfefcfa 0xfaf9f7f7 0x39010000 0x31d2 0x40407 0x709090a 0xfcfcfa 0xfaf9f7f7 0x40407 0x709090a 0xfcfcfa 0xfaf9f7f7 0x40407 0x709090a 0xfcfcfa 0xfaf9f7f7 0x39010000 0x31d4 0x00 0xffffff 0x10101 0x2020303 0x00 0xffffff 0x10101 0x2020303 0x00 0xffffff 0x10101 0x2020303 0x39010000 0x31d5 0xfefefe 0xffffffff 0x10101 0x2020303 0xfefefe 0xffffffff 0x10101 0x2020303 0xfefefe 0xffffffff 0x10101 0x2020303 0x39010000 0x31d6 0x30202 0x1000000 0xffff 0x00 0x30202 0x1000000 0xffff 0x00 0x30202 0x1000000 0xffff 0x00 0x39010000 0x3f0 0xaa103901 0x00 0x3d08435 0x39010000 0x3ff 0x5a003901 0x00 0x3f0aa00 0x5010000 0x78000111 0x5010000 0x129>;
				qcom,mdss-dsi-off-command = [15 01 00 00 0a 00 02 28 00 15 01 00 00 78 00 02 10 00];
				qcom,mdss-dsi-on-command-state = "dsi_lp_mode";
				qcom,mdss-dsi-off-command-state = "dsi_lp_mode";
				qcom,mdss-dsi-lp1-command;
				qcom,mdss-dsi-lp1-commandd-state = "dsi_hs_mode";
				qcom,mdss-dsi-nolp-command;
				qcom,mdss-dsi-nolp-command-state = "dsi_hs_mode";
				qcom,compression-mode = "dsc";
				qcom,mdss-dsc-version = <0x12>;
				qcom,mdss-dsc-scr-version = <0x00>;
				qcom,mdss-dsc-slice-height = <12>;
				qcom,mdss-dsc-slice-width = <540>;
				qcom,mdss-dsc-slice-per-pkt = <2>;
				qcom,mdss-dsc-bit-per-component = <10>;
				qcom,mdss-dsc-bit-per-pixel = <8>;
				qcom,mdss-dsc-block-prediction-enable;
			};
		};
	};
};

&dsi_m20_42_0d_0b_dsc_vid {
	mi,panel-id = <0x004D3230 0x00420D00>;
	mi,hbm-51-ctl-flag;
	mi,bl-51ctl-32bit-flag;
	mi,aod-bl-51ctl-flag;
	mi,hbm-bl-min-level = <1>;
	mi,hbm-bl-max-level = <2047>;
	mi,max-brightness-clone = <4095>;
	mi,thermal-dimming-flag;
	mi,panel-hbm-backlight-threshold = <2047>;
	mi,flatmode-update-flag;
	mi,panel-aod-to-off-command-need-enabled;
	mi,panel-on-dimming-delay = <120>;
	mi,aod-brightness = <20 245>;
	mi,doze-hbm-dbv-level = <245>;
	mi,doze-lbm-dbv-level = <20>;
	/* IRQF_ONESHOT | IRQF_TRIGGER_FALLING */
	mi,esd-err-irq-gpio = <&tlmm 3 0x2002>;
	qcom,esd-check-enabled;
	qcom,esd-aod-check-enabled;
	qcom,mdss-dsi-display-timings {
		timing@0 {
			mi,mdss-dsc-panel-id = <0x004D3230 0x00360200>;
			mi,mdss-dsi-hbm-on-command = [39 01 00 00 00 00 03 51 0f ff];
			mi,mdss-dsi-hbm-on-command-state = "dsi_hs_mode";
			mi,mdss-dsi-hbm-off-command = [39 01 00 00 00 00 03 51 07 ff];
			mi,mdss-dsi-hbm-off-command-state = "dsi_hs_mode";
			mi,mdss-dsi-before-enter-hbm-command = <0x39000000 0x3f0 0xaa103901 0x00 0x3d08425>;
			mi,mdss-dsi-before-enter-hbm-command-state = "dsi_hs_mode";
			mi,mdss-dsi-before-exit-hbm-command = <0x39000000 0x3f0 0xaa103901 0x00 0x3d08435>;
			mi,mdss-dsi-before-exit-hbm-command-state = "dsi_hs_mode";
			mi,mdss-dsi-doze-hbm-command = [39 01 00 00 00 00 07 51 00 f5 07 ff 03 ff];
			mi,mdss-dsi-doze-hbm-command-state = "dsi_hs_mode";
			mi,mdss-dsi-doze-lbm-command = [39 01 00 00 00 00 07 51 00 14 07 ff 01 ff];
			mi,mdss-dsi-doze-lbm-command-state = "dsi_hs_mode";
			mi,mdss-dsi-doze-hbm-nolp-command = [39 01 00 00 00 00 07 51 00 f5 07 ff 03 ff];
			mi,mdss-dsi-doze-hbm-nolp-command-state = "dsi_hs_mode";
			mi,mdss-dsi-doze-lbm-nolp-command = [39 01 00 00 00 00 07 51 00 14 07 ff 01 ff];
			mi,mdss-dsi-doze-lbm-nolp-command-state = "dsi_hs_mode";
			mi,mdss-dsi-doze-none-nolp-command;
			mi,mdss-dsi-doze-none-nolp-command-state = "dsi_hs_mode";
			mi,mdss-dsi-flat-mode-on-command = [39 00 00 00 00 00 03 f0 aa 11 15 01 00 00 00 00 02 d5 71];
			mi,mdss-dsi-flat-mode-on-command-state = "dsi_hs_mode";
			mi,mdss-dsi-flat-mode-off-command = [39 00 00 00 00 00 03 f0 aa 11 15 01 00 00 00 00 02 d5 70];
			mi,mdss-dsi-flat-mode-off-command-state = "dsi_hs_mode";
			mi,mdss-dsi-timing-switch-gir-command = [39 00 00 00 00 00 03 f0 aa 11 15 01 00 00 00 00 02 d5 71];
			mi,mdss-dsi-timing-switch-gir-command-state = "dsi_hs_mode";
			mi,mdss-dsi-fps-120-gamma-command = [15 01 00 00 00 00 02 6c 02];
			mi,mdss-dsi-fps-120-gamma-command-state = "dsi_lp_mode";
			mi,mdss-dsi-fps-90-gamma-command = [15 01 00 00 00 00 02 6c 01];
			mi,mdss-dsi-fps-90-gamma-command-state = "dsi_lp_mode";
			mi,mdss-dsi-fps-60-gamma-command = [15 01 00 00 00 00 02 6c 00];
			mi,mdss-dsi-fps-60-gamma-command-state = "dsi_lp_mode";
		};
	};
};
